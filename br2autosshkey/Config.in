## br2autosshkey/package/autosshkey/Config.in
```kconfig
config BR2_PACKAGE_AUTOSSHKEY
	bool "autosshkey"

config BR2_PACKAGE_AUTOSSHKEY_USERS
	depends on BR2_PACKAGE_AUTOSSHKEY
	string "space separated list of users to generate keys for"

config BR2_PACKAGE_AUTOSSHKEY_SUDOUSERS
	depends on BR2_PACKAGE_AUTOSSHKEY
	string "space separated list of users to allow password-less sudo"
```

## br2chenxing/package/snander/Config.in
```kconfig
config BR2_PACKAGE_HOST_SNANDER
        bool "host_snander"
	depends on BR2_HOST_GCC_AT_LEAST_4_9 # host-libusb
	help
	  SNANDer
```

## br2dongshanpione/board/100ask/dongshanpione/kernel_rescue.its
```
/dts-v1/;

/ {
	description = "DongshanPi One";
	#address-cells = <1>;

	images {
		kernel-0 {
			data = /incbin/("../../images/zImage");
			type = "kernel";
			arch = "arm";
			os = "linux";
			compression = "none";
			load = <0x21800000>;
                        entry = <0x21800000>;
			hash-1 {
				algo = "crc32";
			};
			hash-2 {
				algo = "sha1";
			};
		};
		fdt-0 {
			data = /incbin/("../../images/mstar-infinity2m-ssd202d-100ask-dongshanpione.dtb");
			type = "flat_dt";
			arch = "arm";
			compression = "none";
			hash-1 {
				algo = "crc32";
			};
			hash-2 {
				algo = "sha1";
			};
		};
		fdt-1 {
			data = /incbin/("../../images/mstar-infinity2m-ssd202d-100ask-dongshanpione-carrier.dtb");
			type = "flat_dt";
			arch = "arm";
			compression = "none";
			hash-1 {
				algo = "crc32";
			};
			hash-2 {
				algo = "sha1";
			};
		};
		ramdisk-0 {
			data = /incbin/("../../images/rootfs.cpio.lz4");
			type = "ramdisk";
			arch = "arm";
			os = "linux";
			compression = "none";
			hash-1 {
				algo = "crc32";
			};
			hash-2 {
				algo = "sha1";
			};
		};
	};

	configurations {
		default = "ssd202d-dongshanpione";
		ssd202-dongshanpione {
			description = "Linux kernel, FDT blob, ramdisk";
			kernel = "kernel-0";
			fdt = "fdt-0";
			ramdisk = "ramdisk-0";
		};
		ssd202d-dongshanpione {
			description = "Linux kernel, FDT, ramdisk";
			kernel = "kernel-0";
			fdt = "fdt-1";
			ramdisk = "ramdisk-0";
		};
	};
};
```
